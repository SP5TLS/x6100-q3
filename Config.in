## Config.in
```kconfig
menu "x6100-q3 (Xiegu X6100)"
	source "$BR2_EXTERNAL_X6100_PATH/package/x6100-launcher/Config.in"
	source "$BR2_EXTERNAL_X6100_PATH/package/x6100-btd/Config.in"
	source "$BR2_EXTERNAL_X6100_PATH/package/ioquake3/Config.in"
endmenu
```

## package/ioquake3/Config.in
```kconfig
config BR2_PACKAGE_IOQUAKE3
	bool "ioquake3"
	depends on BR2_PACKAGE_SDL2_KMSDRM
	depends on BR2_PACKAGE_MESA3D_OPENGL_EGL
	select BR2_PACKAGE_ZLIB
	select BR2_PACKAGE_JPEG
	select BR2_PACKAGE_LIBVORBIS
	select BR2_PACKAGE_OPUSFILE
	help
	  Quake III Arena engine (ioquake3) on the Mali-400 GPU: Mesa's
	  lima driver, desktop OpenGL through EGL, SDL2's KMS/DRM video
	  driver. The OpenGL1 renderer turns the picture for the X6100's
	  sideways panel (r_rotate) and applies the gamma ramp in the same
	  pass. zlib, libjpeg, Ogg Vorbis and Opus come from Buildroot, not
	  ioquake3's bundled copies.

	  No game data is included: it is the user's own copy of the
	  game, uploaded through x6100-launcher's web page.

	  https://ioquake3.org/

comment "ioquake3 needs SDL2 with KMS/DRM and Mesa with EGL"
	depends on !BR2_PACKAGE_SDL2_KMSDRM || !BR2_PACKAGE_MESA3D_OPENGL_EGL
```

## package/x6100-btd/Config.in
```kconfig
config BR2_PACKAGE_X6100_BTD
	bool "x6100-btd"
	depends on BR2_PACKAGE_BLUEZ5_UTILS
	depends on BR2_USE_WCHAR # libglib2
	depends on BR2_TOOLCHAIN_HAS_THREADS # libglib2
	depends on BR2_USE_MMU # libglib2
	select BR2_PACKAGE_LIBGLIB2
	help
	  Bluetooth pairing agent: accepts pairing only while a pairing
	  window is open (x6100-bt pair / discoverable), with "Just
	  Works" for keyboards, mice and headphones.

comment "x6100-btd needs bluez5-utils"
	depends on !BR2_PACKAGE_BLUEZ5_UTILS
```

## package/x6100-launcher/Config.in
```kconfig
config BR2_PACKAGE_X6100_LAUNCHER
	bool "x6100-launcher"
	depends on BR2_PACKAGE_HOST_RUSTC_TARGET_ARCH_SUPPORTS
	select BR2_PACKAGE_HOST_RUSTC
	help
	  What the X6100 shows at start-up: play Quake 3, set up Wi-Fi
	  and Bluetooth, power off, with the radio's knobs and keys or a
	  keyboard and mouse; and a web page on port 80 for uploading the
	  game data and the same settings. Run by init in place of a
	  radio UI (/usr/libexec/x6100/launcher-run).

	  Source: launcher/ in this tree (Rust, no dependencies).
```
